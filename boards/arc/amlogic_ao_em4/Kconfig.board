## boards/arc/amlogic_ao_em4/Kconfig.board
```kconfig
# Copyright (c) 2021 Martin Blumenstingl <martin.blumenstingl@googlemail.com>
#
# SPDX-License-Identifier: Apache-2.0

config BOARD_AMLOGIC_AO_EM4
	bool "Amlogic Meson Always-On ARC EM4"
	depends on SOC_ARC_EMSDP
```

## boards/arc/amlogic_ao_em4/Kconfig.defconfig
```kconfig
# Copyright (c) 2021 Martin Blumenstingl <martin.blumenstingl@googlemail.com>
# SPDX-License-Identifier: Apache-2.0

if BOARD_AMLOGIC_AO_EM4

config BOARD
	default "amlogic_ao_em4"

endif # BOARD_AMLOGIC_AO_EM4
```

## boards/arc/amlogic_ao_em4/amlogic_ao_em4_defconfig
```kconfig
# SPDX-License-Identifier: Apache-2.0

CONFIG_CPU_ARCEM=y
CONFIG_SOC_ARC_EMSDP=y
CONFIG_SOC_EMSDP_EM4=y
CONFIG_BOARD_AMLOGIC_AO_EM4=y
CONFIG_SYS_CLOCK_TICKS_PER_SEC=100
CONFIG_XIP=n
CONFIG_HARVARD=n
CONFIG_BUILD_NO_GAP_FILL=y
CONFIG_BUILD_OUTPUT_BIN=n
CONFIG_PRINTK=y
CONFIG_ARCV2_INTERRUPT_UNIT=y
CONFIG_ARCV2_TIMER=y
CONFIG_SERIAL=y
CONFIG_UART_CONSOLE=y
CONFIG_UART_AMLOGIC=y
CONFIG_CONSOLE=y
CONFIG_MULTITHREADING=n
CONFIG_CACHE_FLUSHING=n
CONFIG_BOOT_BANNER=n
```

## boards/arc/meson8_ao_em4/Kconfig.board
```kconfig
# Copyright (c) 2021 Martin Blumenstingl <martin.blumenstingl@googlemail.com>
#
# SPDX-License-Identifier: Apache-2.0

config BOARD_MESON8_AO_EM4
	bool "Amlogic Meson8/8b/8m2 Always-On ARC EM4"
	depends on SOC_ARC_EMSDP
```

## boards/arc/meson8_ao_em4/Kconfig.defconfig
```kconfig
# Copyright (c) 2021 Martin Blumenstingl <martin.blumenstingl@googlemail.com>
# SPDX-License-Identifier: Apache-2.0

if BOARD_MESON8_AO_EM4

config BOARD
	default "meson8_ao_em4"

endif # BOARD_MESON8_AO_EM4
```

## drivers/serial/Kconfig.amlogic
```kconfig
# Copyright (c) 2020 Linumiz
#
# Author: Parthiban Nallathambi <parthiban@linumiz.com>
# SPDX-License-Identifier: Apache-2.0

config UART_AMLOGIC
	bool "Amlogic Meson UART driver"
	depends on ARC
	select SERIAL_HAS_DRIVER
	help
	  This option enables the Amlogic Meson UART driver, for UART_0.
```

## drivers/serial/Kconfig.meson
```kconfig
# Copyright (c) 2021 Martin Blumenstingl <martin.blumenstingl@googlemail.com>
# SPDX-License-Identifier: Apache-2.0

config UART_MESON
	bool "Amlogic Meson UART driver"
	depends on ARC
	select SERIAL_HAS_DRIVER
	help
	  This option enables the Amlogic Meson UART driver, for UART_0.
```

## dts/bindings/serial/amlogic,uart.yaml
```yaml
description: Amlogic Meson UART IP

compatible: "amlogic,meson-uart"

include: uart-controller.yaml

properties:
    reg:
      required: true
```
